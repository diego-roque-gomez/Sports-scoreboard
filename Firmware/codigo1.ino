#include <WiFi.h>
#include <WebServer.h>
#include <DNSServer.h>
#include <MD_Parola.h>
#include <MD_MAX72XX.h>
#include <SPI.h>
#include <ESP32Servo.h>

#define HARDWARE_TYPE MD_MAX72XX::DR0CR0RR1_HW

//Información de la red wifi
const char* ssid = "ControlEstadio";
const char* password = "56781234";

//Dominio para acceder a los controles desde el explorador
const char* domain = "control.pantalla";

//Pines a utilizar
const uint8_t DATA_PINM1 = 23;
const uint8_t DATA_PIND1 = 22;  //Checar que este pin este bien
const uint8_t CLK_PIN = 19;
const uint8_t CS_PIN = 15;
const uint8_t servoPin1 = 18;
const uint8_t servoPin2 = 21;

Servo servo1;
Servo servo2;

//Instancia matriz led
MD_MAX72XX matriz(HARDWARE_TYPE, DATA_PINM1, CLK_PIN, CS_PIN, 1);
MD_MAX72XX display(HARDWARE_TYPE, DATA_PIND1, CLK_PIN, CS_PIN, 2);

//Servidores
WebServer server(80);
DNSServer dnsServer;

//Buffer para guardar html
char bufferhtml[65536];

const uint8_t numerosmatriz[10][3] = {
  {0x7F, 0x41, 0x7F},  // 0
  {0x40, 0x7F, 0x42},  // 1
  {0x4F, 0x49, 0x79},  // 2
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  {0x7F, 0x09, 0x0F}   // 9
};

const uint8_t numerosdisplay[10] = {
  0x7E,  // 0 01111110
  0x30,  // 1 00110000
  0x6D,  // 2 01101101
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  0x7F,  // 8 01111111
  0x7B   // 9 01111011
};


bool running = false;
bool pausa = false;
bool cronometro;

int minutos = 0;
int segundos = 0;
uint32_t tiempo = 0;
uint32_t tiempoAnterior = 0;
uint32_t tiempoActual = 0; 

uint8_t v1 = 0;
uint8_t v2= 0;
uint8_t v3= 0;
uint8_t v4= 0;
uint8_t v5= 0;
uint8_t v6= 0;
uint8_t v7= 0;
uint8_t v8= 0;
uint8_t v9= 0;
uint8_t v10= 0;

// Código html
const char* html PROGMEM = R"rawliteral(
<!DOCTYPE html>
<html lang="es">
<head>
  <meta charset="UTF-8">
  <title>Controles estadio</title>
  <style>
    input[type="number"]::-webkit-inner-spin-button,
    input[type="number"]::-webkit-outer-spin-button {
      -webkit-appearance: none;
      margin: 0;
    }

    html, body {
      margin: 0;
      padding: 0;
      height: 100%%;
      overflow: hidden;
      position: relative;
    }

    img.fondo {
      width: 100vw;
      height: 100vh;
      object-fit: fill;
      position: fixed;
      top: 0;
      left: 0;
      z-index: -1;
    }

    .input-personalizado {
      position: absolute;
      padding: 5px;
      font-size: 16px;
      text-align: center;
      border: 1px solid #ccc;
      background-color: rgba(255, 255, 255, 0.8);
      box-shadow: 2px 2px 8px rgba(0, 0, 0, 0.15);
      transition: all 0.2s ease;
    }

    .input-personalizado:focus {
      border-color: #4a90e2;
      box-shadow: 0 0 10px rgba(74, 144, 226, 0.4);
      outline: none;
      background-color: white;
    }

  </style>
</head>
<body>
  <img class="fondo" src="data:image/jpeg;base64,/9j/4AAQSkZJRgABAQAAAQABAAD/4gHYSUNDX1BST0ZJTEUAAQEAAAHIAAAAAAQwAABtbnRyUkdCIFhZWiAH4AABAAEAAAAAAABhY3NwAAAAAAAAAAAAAAAAAAAAAAAAAAAAAAAAAAAAAQAA9tYAAQAAAADTLQAAAAAAAAAAAAAAAAAAAAAAAAAAAAAAAAAAAAAAAAAAAAAAAAAAAAAAAAAAAAAAAAAAAAlkZXNjAAAA8AAAACRyWFlaAAABFAAAABRnWFlaAAABKAAAABRiWFlaAAABPAAAABR3dHB0AAABUAAAABRyVFJDAAABZAAAAChnVFJDAAABZAAAAChiVFJDAAABZAAAAChjcHJ0AAABjAAAADxtbHVjAAAAAAAAAAEAAAAMZW5VUwAAAAgAAAAcAHMAUgBHAEJYWVogAAAAAAAAb6IAADj1AAADkFhZWiAAAAAAAABimQAAt4UAABjaWFlaIAAAAAAAACSgAAAPhAAAts9YWVogAAAAAAAA9tYAAQAAAADTLXBhcmEAAAAAAAQAAAACZmYAAPKnAAANWQAAE9AAAApbAAAAAAAAAABtbHVjAAAAAAAAAAEAAAAMZW5VUwAAACAAAAAcAEcAbwBvAGcAbABlACAASQBuAGMALgAgADIAMAAxADb/2wBDAAMCAgICAgMCAgIDAwMDBAYEBAQEBAgGBgUGCQgKCgkICQkKDA8MCgsOCwkJDRENDg8QEBEQCgwSExIQEw8QEBD/2wBDAQMDAwQDBAgEBAgQCwkLEBAQEBAQEBAQEBAQEBAQEBAQEBAQEBAQEBAQEBAQEBAQEBAQEBAQEBAQEBAQEBAQEBD/wAARCAImBDEDASIAAhEBAxEB/8QAHQABAAEEAwEAAAAAAAAAAAAAAAUEBggJAQMHAv/EAGUQAAEDAgIDBBEOCAwEBQQDAAABAgMEBQYRBxIhMVFVlAgTFBUWGDVBVldzdJOy0dLTCRkiMjQ2YXGRkrGztNQXOFR1gZWWtSMzN0JGUlNYdoShoyRicsMlQ0SCwUVHY6Jkg/D/xAAYAQEBAQEBAAAAAAAAAAAAAAAAAQIDBP/EACIRAQACAQQDAQEBAQAAAAAAAAABEQISEzFRAyFBMmEigf/aAAwDAQACEQMRAD8A2pgAAAAAAAAAAAAAAAAAAAAAAAAAAAAAAAAAAAAAAAAAAAAAAAAAAAAAAAAAAAAAAAAAAAAAAAAAAAAAAAAAAAAAAAAAAAAAAAAAAAAAAAAAAAAAAAAAAAAAAAAAAAAAAAAAAAAAAAAAAAAAAAAAAAAAAAAAAAAAAAAAAAAAAAAAAAAAAAAAAAAAAAAAAAAAAAAAAAAAAAAAAAAAAAAAAAAAAAAAAAAAAAAAAAAAAAAAAAAAAAAAAAAAAAAAAAAAAAAAAAAAAAAAAAAAAAAAAAAAAAAAAAAAAAAAAAAAAAAAAAAAAAAAAAAAAAAAAAAAAAAAAAAAAAAAAAAAAAAAAAAAAAAAAAAAAAAAAAAAAAAAAAAAAAAAAAAAAAAAAAAAAAAAAAAAAAAAAAAAAAAAAAAAAAAAAAAAAAAAAAAAAAAAAAAAAAAAAAAAAAAAAAAAAAAAAAAAAAAAAAAAAAAAAAAAAAAAAAAAAAAAAAAAAAAAAAAAAAAAAAAAAAAAAAAAAAAAAAAAAAAAAAAAAAAAAAAAAAAAAAAAAAAAAAAAAAAAAAAAAAAAAAAAAAAAAAAAAAAAAAAAAAAAAAAAAAAAAAAAAAAAAAAAAAAAAAAAAAAAAAAAAAAAAAAAAAAAAAAAAAAAAAAAAAAAAAAAAAAAAAAAAAAAAAAAAAAAAAAAAAAAAAAAAAAAAAAAAAAAAAAAAAAAAAAAAAAAAAAAAAAAAAAAAAAAACgv95pcOWK5Yhro5X01rpJq2ZsSIr3MjYr3I1FVEVcmrlmqbeuYwQ+qR6DpoY5m4Ux0iSNR6ItDR5oipnt/4osYzlwl0yuBip649oP7Fcc8Ro/vI9ce0H9iuOeI0f3k1t5dFwyrBip649oP7Fcc8Ro/vI9ce0H9iuOeI0f3kbeXRcMqwYqeuPaD+xXHPEaP7yPXHtB/YrjniNH95G3l0XDKsGKnrj2g/sVxzxGj+8j1x7Qf2K454jR/eRt5dFwyrBip649oP7Fcc8Ro/vI9ce0H9iuOeI0f3kbeXRcMqwYqeuPaD+xXHPEaP7yPXHtB/YrjniNH95G3l0XDKsGKnrj2g/sVxzxGj+8j1x7Qf2K454jR/eRt5dFwyrBip649oP7Fcc8Ro/vI9ce0H9iuOeI0f3kbeXRcMqwYqeuPaD+xXHPEaP7yPXHtB/YrjniNH95G3l0XDKsGKnrj2g/sVxzxGj+8j1x7Qf2K454jR/eRt5dFwyrBip649oP7Fcc8Ro/vI9ce0H9iuOeI0f3kbeXRcMqwYqeuPaD+xXHPEaP7yPXHtB/YrjniNH95G3l0XDKsGKnrj2g/sVxzxGj+8j1x7Qf2K454jR/eRt5dFwyrBip649oP7Fcc8Ro/vI9ce0H9iuOeI0f3kbeXRcMqwYqeuPaD+xXHPEaP7yPXHtB/YrjniNH95G3l0XDKsGKnrj2g/sVxzxGj+8j1x7Qf2K454jR/eRt5dFwyrBip649oP7Fcc8Ro/vI9ce0H9iuOeI0f3kbeXRcMqwYqeuPaD+xXHPEaP7yPXHtB/YrjniNH95G3l0XDKsGKnrj2g/sVxzxGj+8j1x7Qf2K454jR/eRt5dFwyrBip649oP7Fcc8Ro/vI9ce0H9iuOeI0f3kbeXRcMqwYqeuPaD+xXHPEaP7yPXHtB/YrjniNH95G3l0XDKsGKnrj2g/sVxzxGj+8j1x7Qf2K454jR/eRt5dFwyrBip649oP7Fcc8Ro/vI9ce0H9iuOeI0f3kbeXRcMqwYqeuPaD+xXHPEaP7yPXHtB/YrjniNH95G3l0XDKsGKnrj2g/sVxzxGj+8j1x7Qf2K454jR/eRt5dFwyrBip649oP7Fcc8Ro/vI9ce0H9iuOeI0f3kbeXRcMqwYqeuPaD+xXHPEaP7yPXHtB/YrjniNH95G3l0XDKsGKnrj2g/sVxzxGj+8j1x7Qf2K454jR/eRt5dFwyrBip649oP7Fcc8Ro/vJ6foJ5JnAnJCVmIKLBlov9E/DkVFLVOukEMbZEqVnRiR8rlkVVTmZ+tmibrcs9uUnDKPcwXD1wAGVAAAAAAAAAeaYu5JPQXgPEdbhHF+kq1Wu8W9Y0qqOZX68SvjbIzPJqptY9jvichD9ODyM/bhsf+75hakexg8c6cHkZ+3DY/wDd8wdODyM/bhsf+75gqR7GDxzpwuRn7cNj/wB3zB04XIzduGx/LJ5gqS3sYPHOnC5Gbtw2P5ZPMHThcjN24bH8snmCpS4exg8c6cLkZu3DY/8Ad8wdOHyM3bhsf+75gqVt7GDxzpw+Rm7cNj/3fMOOnD5Gbtw2T/d8wVJb2QHjfTh8jN24bJ/u+YOnE5Gbtw2T/d8wVJb2QHjfTicjL24bJ/u+YOnE5Gbtw2T/AHfMFSW9kB4304nIy9uGyfJL5g6cTkZe3DZPkl8wVJb2QHjXTi8jL24LL8kvmDpxeRl7cFl+SXzBUlvZQeNdOLyMvbgsvyS+YOnF5GXtwWX5JfMFSW9lB41043Iy9uCy/Nl8wdONyMvbgsvzZfMFSlw9lB4z04/Iy9t+zfNl8wdORyMvbfs3zZfMGmei4ezA8Y6cjkZe29Z/my+YOnJ5GXtu2f5svmDTJcPZweMdOTyMvbds/wA2XzDheTK5GVP/ALuWj5svmF0yXD2gHi3Tl8jL227T8yXzB05nIy9tq0/Ml8waZLh7SDxXpzORm7bNq+ZL5o6c3kZu2zavmS+aNMlw9qB4p053Izdti1/Ml80dOdyM3bYtfzJfNGiS4e1g8U6c7kZu2va/mS+acdOfyM3bXtnzJfNGiS4e2A8T6c/kZu2tbPmSeaOnQ5GbtrWz5kvmjRJcPbAeJ9OhyM3bVtnzJPNHTocjN21bZ8yTzRoyLh7YDxLp0ORm7att+ZJ5o6dDkZu2rbfmSeaNGXRcPbQeJdOhyM3bVtvzJPNHTpcjN21bb8yTzRoy6Lh7aDxHp0uRm7att+ZJ5oXk0uRm7alu8HJ5o0ZdFw9uB4j06XIzdtO3eDk80dOnyM/bTt3g5PNGjLouHtwPEenT5GftpW7wcnmnHTp8jP20rf4OTzRoyLh7eDxDp1ORn7aVv8HJ5o6dTkZ+2lb/AAcnmjRkXD28HiHTqcjP20rf4OTzR06nIz9tK3+Dk80aMjVD28HiHTqcjP20rf4OTzS9tGemzRjpgdcmaOcV015dZ0gWtSFHIsKTcs5Wq5ontuVSZf8ASonGY9yXC+QAZUAAAAAAAAAAFraVP5MMX/mG4fZ3mlmi9xU/cWeKhum0qfyYYv8AzDcPs7zSzRe4qfuLPFQ9Hg+sZu8AHoZAAAAAAAAAAAAAAAAAAAAAAAADorK6kt8C1NbO2GJHNbrOz9sq5ImzdVVO8iMTbKWi/OVH9c0k+oEjSVdNXU7KujmbLDJmrXt3FyXJf9UU7iIwr1Ei7rP9c86MU100MbaSOWaKJaeerqXwqqSLDE1FVjHfzXOVyJnuomeW+L9WK+uvtntz1irLjCyVqZrEi68nzG5u/wBCiZjXDb3NalZNm9cm50cyZ/8A6HRZsI2ttJFPXwRzvlakixNzSBmaZ5Izcdu+2fm5d3Mklw7h9Ykh5x0CMb7VEpmJl8WzYT2O+iuduuTXOt9dBUI32yRvRyt+NN1P0lUWnecOUNtfTV9HJNExaiKnVqSrrx8scjGvievsmqiq32GascmaK0o6y8XC50stLPImVC1Y52scsbaqZal0DNZU9k2LNquciLtzyzyTauuRctViWw0b3xTXSBZI89aOJVlemW77FmanRFjHDssqQtrZGuXc16WVqfKrTijwfZqaFsVXTtrXNTJeWtTlSf8ATEnsGJ8SZ76rulW7D9hexkbrJQasftU5nYmr8WzYP9DvorjQXGPltBWw1DU3Vjejsvjy3P0lSQUWDbTT3OC500lVE6nXWZG2X2Oe5lmvs9X/AJNbV+ArrtdFt0ccdPBzRWVLtSmgRctd3XVy9ZjU2qvWT4VRC32O6S40ENbFbpayFlVO1XRwq5Ec5E66J+hfkXeKk8155W6ppKmvffaKVHycsljc9rKiqc1f41iqucSsy/gm7yey9tsvHD1855QsgqZWPndEk0MrW6raqBdyVqdZes5v81fgVCRlYrai7W2lq46GorGMqJdXVjXPP2S5N+LNdiZlYWzdFXn/AFPcbd9qcXMWJAAFAAAAAAAAAAAAAAAAAAAAAAAAAzW9TE6u6U+8sPfWXMwpM1vUxOrulPvLD31lzOfl/ErjyzyAB43QAAAAAAABqg5NFEXkpcf7E/j7b+6qM8VyTeQ9q5NH8aTH/d7b+6qM8WPdh+Ycp5cZJvIMk3kOQaHGSbyDJN5DkAcZJvIMk3kOQBxkm8
  gyTeQ5AHGSbyDJN5DkAcZJvIMk3kOQBxkm8gyTeQ5AHGSbyDJN5DkAcZJvIMk3kOQBCU2KKOe7S2magqaZ0c7qZssqIjHyImaIm9rJtaq7uW+TWqm8hBYmsfN8Tq6mgWSdsfK5okdqrUQoueqi9Z7V9kx3WXZuKU1uxbFFb0irHrVVmqnMiMTJ1cirk1UT+a/NMnp/NVFXcM3XIkb7iGjsMaLLTy1EvK3TLFEiZtibuvVV3EzyROuqrkh0MxTA6vp7e601jHTpBrvc1ESF8rXOYxybufsVz+EjrFbJL1Vuu1we2eFJUkV6e1qZ27E1f/wx7jE/nOzdvHNeq9FUqptXm62/VzC55HfccdW2ikWOmoKms9tqvjbk1+quS6uxVVEXZnllmfVuxzZa6oipZ4p6KWeRsUTZm+3eqbG76Ku3dTLZulNU4bvtsqWV2Ha9JEijdDEx2SPbFrK5Is19i9qKq5Z7UObdiWKWsa3ENpigrI3NidUJHksbnLk3XRdrUVdiORVTPeJc37H3XY+oaKsWjWyXCZVnmp45I2IrXuiXKRdm1ERVTau+fPR/Takr+cFciQaiyaytRW666rNi7dq7E+EprDmmJYu+r19fEcYn6v1H/RZvtzxc1apiy4phvVa6hbaK2lc2JZdeZmTFRFRMs8t3b/opLVlZS2+lkrayVIoYkzc5f9EROuqrsROup2yyxwxvmmkbHHGive9y5I1E3VVTz/EGI2VlVSzTzrTw8tzgjRNaSBmWfND2f13IuUaL7VF1l2lmaj2i9LVdILrDI+OCanlhfyuannbqyRO3URyfCm1F6523KugtdvqblUtcsVLE+Z6NTNVa1M1y+HYef0d5oKa8RJh+skVrWLylat2rrJntpnuVdqKq5scvtXZpuKXRf7jTXTBF3rKVXI1aKoa5j0yfG9GqjmOTrORdiiMvRSStl5obprRw68NSxM5KaZupKz4VTrp8KZoV2SbxZPOOsvdddq2CvelRS1yRQskcqNa1IYlRGOTaxc3LtTZt2oVVBiqvttQtuxHTSq5v/mIxOWom+rU2SJ/zM276CMuynfW46oqKqnpltFfKkUskDHxsRUlfG5jXoibuzXRc95FOpMfUypIq2KubymJZn62TdWNFRFdt6yKqfKUNjqIKnElNUUszZYpLhd1a9i5oqfwR2Y92zz58B1X10BLmrFS7SFRs/jbDc2IqexXlexXKqIjc8skzVUQ+nY+gbI+JcPXFXRPdG9GojtVzVyVM0TLNF2FfjJV6H5dv/qKX7RGW9Qz43jkuDMO0lPJQpcqvUdMrUdrcudrfo1s8vgEzMTSpWnx1BPUwUy2C5R8vlZEj1jzRquVERV2biZ7fgLmyTeLVoarSStdTtrrfQpTOkak7tdubY/5ypltzy3C6y439Rxkm8Mk3jkGhxkm8Mk3jkAcZJvDJN45AHGSbwyTeOQBxkm8Mk3jkAcZJvDJN45AHGSbwyTeOQBxkm8Mk3jkAcZJvGbfqYyJz10oLl/6awePcTCUza9TG6qaUO9rD49xOfl/ErjyzuAB43QAAAAAAAAAAFraVP5MMYfmG4fZ3mlmi9xU/cWeKhum0q/yX4w/MFw+zvNLNF7ip+4s8VD0eD6xm7zhVRqK5yoiJtVV6xyUl36kV3e0viKehl1NxDYHLqtvdAq73NLPKVcVXSzxulgqYZWM9s5j0cifGqHnNNaLlVrUTW/B1mubUWJqT1kiMe1UgizblvJ1vjUrrVhO60EdZdK6loLcroZ5H09E9zkdrRK3UXPZq5+z3V25ZZbc8ap6F8U1VS1sKVFHURTxKqoj43o5q5fCh8y1tHBPHSzVcMc038XG56I5/xJuqRGEZ6aSjqWwSxqiVGtk1U3HRsVFy3lTaReIuVzYuoGxq172LSNVEVFVq8vV2XwLqtVfiRS36sXdFPBMr2wzRyLE7UejXIuq7eXLcU+9wsZlmrLjdKie03BaCrhdPIj2NRElVah6ZPVNqpkmzPNE3lKtMWXOz50WLra6JXIrWVcDdaN65byf/ABt/5UGrsT7sQWFqIrr3QIi5on/Es25bvXOExFYFVES+UGa7n/Es8pbWGsO2S4w1Utzs1LPLGynY10sKK5qczRrlt+E6MGWKzXZlRLc7XTVb4oaNrHTRo5WpyhFyTP4Rci/E27h8Q1EFSxZKeeOViKrVcxyOTNN1M065ZOL8VTzQy2ywU9RVI1EbJzLG575UzyVG6u4xNubs0zy1WruqkJZ73cLHcHVFNaLtBR8rby7m2kSFkips1c2pqtX+q5cv6rlVMlSTnETRT1U6Zaykgmip56qKOWZco2OeiOf8SLunVRXWguFPFU09SzVmVWta9dV6OTdarV2o5OuhCX18K4iomK5ivRKfJF3UzqEy+hfkNTIl5r/YqaV0FReqGKRi6rmPqGo5q7ypnsOae+WWrlbBS3eimkfsayOdrnL8SIpYNXbbjcLzKy2WS0XBzFqXSJcM0azOpeiK3Lrr1/iQkrDYb/S3mlqKzCGF6WGNyq6elVeWs2Ltb8PlMxlMi+gAbAAACJxLFUyUEL6WllqXwVlPOscWWu5rJEV2WaoirkhLAT7FjUN3xja6daKmwjJNCySRzHyazXKjnucmaJmiLt3yQonX7EjpGXezOtElIiSUlU12v7Nc0c1WO9s1U3U3FResuSl0gzpFnxpjLDrOUU1vZXUrEyZGx2ujU6yNzVHtT/lVH5ZbuRUTYlxNyrWp8JSa+aexc6RdnzE+kugCv6LTjt2LLzVR1F0fHRRxLrRbGqsTtzWbGiuRX5bjnuVG57G5khX4WpZaGKnt6shkghdTpy1FeyaJy5vZKm6qKu3WRdZHbU66LOAtC0W1eNbNHylbW+vjYiIzNySu8I1UcqZf1o899VO6XEmJ1jRYMJvR+siKjnSLs3/aIn+pdAFf0WxTdGj6nnnXOSKnga5zqKNkaunyRcmNTNdVVXJdZX/Bkm06LbabnfKl9ffKaopGSonL43u1Hv8A6sLFaubYm7qrmivdtXJEyLuAoQvQbhpf/pq8Yl84j7phx9uSOqscdQrI3I9IWPWSSGTcSWPXdtRU9i9meTmr1lTbdQFQWsmrqMQzudc3YZq21NRS0yJEiI5rZYZ3OVHKi5oipkqbu6ffRPjrsLb89/kLzBNP9LUlpqa6rt0FTcqLmOpkbnJBra2oua7M/iyX9JVgGgKS589VpHc5uZeatZurzTrcr1c9vtdueW4VYTdAsBcWYzfQ11dFFZkZbp0gnRzJc1Xlmoqtydt39uR3VeNLtHXpSJW2OiasEcqOrnPjRyqxqqjV1tu125lsTI5bh+9MseIqXmBVmqqxZqdiSN/hWct180XPJNm/ltI+42O+xXNJ+gWmvkPM0UaJUzxtbG5GMRVbnntzaqLsTcTdOftUjU44rLZQQVlVWWWtSSpVjloZHObypETNuarskVzkyz2bf0l1SXi3R2pb2tQi0fK+WpInXTrIib+ezLfLKsmH7nWXujmr8EUdkoKdsivihkikZI5Uy9kibVz9j1v5u6VDMC163JLTLVSOw7HKtW2NXJmrv7Pf3c/gy27qlickEx9XVNlW5UcVE2R1ckDdZXOYkSxq5FXai5orVRV3Ni5CfG17s1zpoLw6x1dLUO1VWgqHLIzbtcqLnsKe8YXvjrvWMobWslBNVxTtVsrETJWvRyZKqKmWuuze3My7o8LYbhV7qey0cTnsdGr2RIjka5MlRF3U2KSNUr6Qcd/xhiPls2F6CipKJquZHU1+sqyKnXRrdxPl+PPND76JMR2GphixdbqRaSdyRtraJzla12X85rtuW7+hOudFBBjXCmVtpbZBe7cj1WKRsyQyxNXaqKi7F2/SvxJzUW7FuLpoIb3RU9otkMvLHwtl5bLMqZom1NiJkq/Fn1y3P/UXmADYAAAAAAAAGa3qYnV3Sn3lh76y5mFJmt6mJ1d0p95Ye+suZz8v4lceWeQAPG6AAAAAAAANUHJo/jSY/wC72391UZ4se08mj+NJj/u9t/dVGeLHuw/MOU8gANAAAAAAAAC3b/jegw7Wcx1lruUqJGkizQwa0SIuezW3M9hRUuk2y1Mkka2u7QOZA6oTl1Pq67UTPJua7VXJcviKzSE5UwdcN3LVZsRFX+enWQtjF+vz2okcx6q2yKq+xVckRH55/KnymMpmFhNU2ky21axcow/fXMmVqMkSjVWqirsXPe+EuG3XugulTWUlK56S0MqxSNe3V1slVFc3fbrI5M99FPLrHfcMU1BQsqca4jp54mR69LFE7lTHJlnG3Z7XPZ8RW2igvNLaYcfW980lTHPK6emcq6slOqprZfBrI936c+sSMpKeiXS90NofSx1ayK+rmbDG2NmsqZuRusu81Fc1FXfVCBuGkm0W+vqretpu9Q+jkdHK+nplkaioqp1vhavyFtXe33i82eux1XOlhk1mcx0zXKjWU6Oyzd11TNUd/wC3Prn1ZLPcsUXq+VttxNcbNGs6OclMzLl2u+RyKusm6iKn6FE5TfopeCY8wtzpW9OuKsgSRYlY5ipLyzJF1NTdzyVPlKF2ku0xRsqamy3qGmev8e6jXVam3au8mwhLjhSHBNyt19pLbVXeihc51ZrezkZIqORZdXr5ordn/Im+TcmlTBro1ZHVVNTKuacyspXLIqputVqoXVP30i5qCvorpSR11vqWTwSpmx7V2L5FKgtTR7a66gt9bV1lK6kbcap1TDSO3YI1TYmXW8iIXWaibgC37hhd1VXOkpalkFJVuV1WzU/hM1TJyxO/mK9E1X76bd0uACYsfEUUcMbIYY2sjjajWtamSNRNxELbvOFa273aZ754Et1W6B06I5zZ05Wx7cmqmxM9dNvWyLnAmLFmtwviy0NfFh6+wthXajZGbVXfVFzair11TdO2lwld62qkqsR3OOblrY2SpGi60kbHa7YlXcazX2qjd0u0E0wWty2YeudHf33CoqKZ1K2StliRiO5Yq1EjHqjs9mzVy2b5xe8OXO43ltbS1FKymkSjSZJEdrpyid0vsctm3Wy2lyAtQILEtqvd2lpY7fUUbaSNVfPFUNcuu/ZqKqJ7Zrdq6q7FXLMr7dZqG3UyU7ImzPVVfJNK1HPleu65yr11K4CvdjomoKGeJ8E1FTvjkarHNWJu1F3U3C1ZsIX3/jqGmulNzDW0ktM90iOWWTNmUbn9ZXN9qrt1zd3aXiBMRIicP22vt7K2W5SU7p62qWoVIEXUanK2MRNu3+Zn+kra63UVzg5nrqdsrEXNuexWrvtXdRfiKkFoW9RYaraG8UdS24Ry0NGyo5Wx0eU2tLq56zk2OT2O6u0+cVYduV7la+31FLG19HLRTcuRyqjXvjdrNy66anX3y4wSoqhHYhttRdrRNQ0kkccznxSMdIiq3NkjX5LltyXVy/SQMFkxxScubRXS3QxzTy1CsRHuRrpHK52Sr1s1Uu8CYv2LapaDHjauB9VeqBadsjVma2NVVzOu1PhXfLlAERQAoL/Vz0FiuVdSuRs1PSTSxqqZojmsVUXL40LClxDdoK2ohqNJNJRLDM6PmeootdyNRdiqqbNqbf0knKh6YDz21YwvtZaLlKlwhrEghlfDWR0qxo3J7UYuS7F1kc7JN3Ni9ZULysM9RUWuN9VOs0rZJo1kVERXakrmoqonXyRCxlYkAWvLeLm3GrbalV/wau5VynUTL3Osmtnu56yfIRVrxveaKlgqb1Ry11G+GF8lXDEjXRPfG16tVE2KiI5PKTVAv0EDX4ipa3DlTcrBco3vakaI5uSuj1pGtVVavwKvwEHVsxs2gde4sXMbSxuRqwcyprq1JEYvstzNdq/pE5C+gWpYKPF9RVRXOrxUyag5bKi0q0yI9zGuc1EV2/miKMS4v5lqWWWzSMWslfyt0quajWKm1WtV3sVcibqrsanw7C6vVyLrBb2F8Ux3hq0NY5ja6JXMXJU1ZdXdyy2I5Ou39KbFLhETYAs199vEcWIJ+blVaZJuZ2rGmUOpO+NMt/YibvXLXmxncIqqqp6vSSyikgqZoeUPtyyOajHuambk2KqoiL+kk5xBT1oFqYBu8t3grZZMVMvaRyMajm0iwcq2KuW3dz/+C6yxNxYGbXqY3VTSh3tYfHuJhKZtepjdVNKHe1h8e4mPL+JXHlncADxugAAAAAAAAAALW0q/yX4w/MFw+zvNLNF7ip+4s8VDdLpW/kuxj+YLh9neaWqL3FT9xZ4qHo8H1jN3nxNFHPC+CZutHI1WPbvoqZKh9g9DKktlro7RTLS0LHtjV2uuvI56quSJuuVV3ERP0FWABbdx0e4Tub9ea3PhdnnnTzPj/wBEXJP0IVllwlYLAqPttDqyNRUSSR7nuTPdyVy7P0EwCVAo6O00NBVT1lNG9slSub9aRzk3VcuSKuTdqquzfKmaGGoidBURMljemTmPajmuTeVF3T7BRR261UFqikhoIFjZK7Xcivc7bkiddVyTJETLcKekw3aaGhqbdSwyshq01ZU5e9XKmrqoiOzzRETYmSkoBUCjtdot9mp1prdT8qYqorlVyuc7JMkzVdq5JsTeKqRjJWOilaj2PRWua5M0VF3UVD6AFtTaOsIVDnyS2tznvTVR3NEmbEyyyb7LZs2foTeO6y4Gw3YJUnoKSVZGu12umnfJquyyzRFXLPLr9YnwTTAt+vwJhm5zuqa2jlke5zn+6JERFcubskRdma7dhxbsBYXtVdDcqGhkZPAqujctQ9yIuWW4q5LsUuEDTAEBQwVd0rLm+W8V8TYK10EbIXta1rEYxeu1euqk+Q+H/dF5/OUniMEjt5yycPXXwzPNHOWTh66+GZ5pJgVAjOcsnD118MzzRzlk4euvhmeaSYFQIznLJw9dfDM80c5ZOHrr4ZnmkmBUCM5yycPXXwzPNHOWTh66+GZ5pJgVAjOcsnD118MzzRzlk4euvhmeaSYFQIznLJw9dfDM80c5ZOHrr4ZnmkmBUCM5yycPXXwzPNOmwSVSV14op62epZSVUbInTKiuRroWOVM0RM9rlJkhbJ1axD35D9njFUJoi7o2ee40FHHXVFNHK2Zz1gciOdqo3LaqLs2qShHVfVu29zqfoYJHzzlk4duvhm+aOcsnDt18M3zSTAoRnOWTh26+Gb5o5yycO3XwzfNJMChGc5ZOHbr4ZvmjnLJw7dfDN80kwKEZzlk4duvhm+aOcsnDt18M3zSTAoRnOWTh26+Gb5o5yycO3XwzfNJMChGc5ZOHbr4ZvmjnLJw7dfDN80kwKEZzlk4duvhm+aOcsnDt18M3zSTAoRnOWTh26+Gb5o5yycO3XwzfNJMChGc5ZOHbr4ZvmjnLJw7dfDN80kwKEdaEmjlr6WWrnqEgqGtY6ZUVyIsTHZZoiddVJEoLf7uunfLPqIyvLAAAAZrepidXdKfeWHvrLmYUma3qYnV3Sn3lh76y5nPy/iVx5Z5AA8boAAAAAAAA1Qcmj+NJj/u9t/dVGeLHtXJpfjSY/wC72391UZ4qe7D8w5TyAA0Bb1PV4ludXceYq2gp4KSsfSsbJAr3KjUauarn8JcJC4a/jb3+d5/FYSRzzNi/he2cUd5RzNi/he2cUd5SZBaENzNi/he2cUd5RzNi/he2cUd5SZAoQq0uLnJk67WtU3lpFVPpC0mLVXN10tSrllto1XZvbpNAlCDShxSm5cLOn+RPpKXFyJqpdrWibyUa5fSTQFCFWlxaqaq3W1qm5ktGuXyZhKXFqZ6t1taZ7uVGqZ/6k0BQhkp8YJuXi2cUd5T4bb8TtfyxtfZ2v/rJQZL8pOAUIbmbF6//AFi2cUd5RzNi/he2cUd5SZBaENzNi/he2cUd5RzNi/he2cUd5SZAoQ3M2L+F7ZxR3lPiGqv9JeaOgudVRVENZHO5FhhVjmKzVVN1dqLrKThD3H3y2XuVZ9EZJEwUF7q6qitsk9EsaTrJFGxZG5tRXyNZmqdfLWzK8jMRdS/8zS/aIyyOnmbF/C9s4o7yjmbF/C9s4o7ykyu6BQhuZsX8L2zijvKOZsX8L2zijvKTIFCG5mxfwvbOKO8o5mxfwvbOKO8pMgUIbmbF/C9s4o7yjmbF/C9s4o7ykyBQhuZsX8L2zijvKOZsX8L2zijvKTIFCG5mxfwvbOKO8o5mxfwvbOKO8pMgUIbmbF/C9s4o7ynXBWX6lvtHbLnU0dRFWQTyIsMKscx0as312ouv/oTpC1/vts3eld/2ST6FbeqKS52eutsT2sfV00sDXO3EVzFRFX4NpTWO0Po6JzbnT0j6mWaSV6sYjmprOVURFVM12ZEsBQpLjbae42yotT0WKGojWNeVIjVbn10+FF2lu01s0hWx0kFHcrRUUzpHSN5bE5rmq5yud/qq5J1i7QJixa9iwxd4bpJfcRXKGoq3q5yRwR6rGuViMRf0MTLJN9SrwlZa+y2x1Fc1p3vXlbE5VmrXMZEyNM8+uupnl8JOgRjEC17vgC01syVttRKKpR7Xua3PlUqoqLk5qfCibhWyWe4SYWfaXPp0rHtVc0VeV6/LNfLfy6xNgVAt6e24liw3FbbXUUkNc97uXSKrtVjHPc52ou7ntREX41KODRphmSliZeaNK+diLm9zlRrVXdRqdZNnxruqXaBpgWlU6O7RSUq9DESW6pa9JWq17tVzk3FXroqdZyfQGUulGN7ZH3Wxz6zcnRrArUavwL19zP8ASXaBpj4WtCkwneudd1juFbSurLhG9GpG1Uja90jpFcq/Crssk3EQ6KSx4/oI5IaV+HljdNLMiSwa7k5Y9z1RVVNuSuyL2BNMCJw/BiGCOdMQLbVcrkWLmKLUTLLbrb65ksAaj0Bm16mN1U0od7WHx7iYSmbXqY3VTSh3tYfHuJz8v4lceWdwAPG6AAAAAAAAAAAtXSv/ACW4x/MFw+zvNLVF7ip+4s8VDdLpX/ktxj/h+4/Znmlqi9xU/cWeKh6PB9Yzd4APQy4X2q/Epb+G7NaajD9uqKi3U8kslMxz3vYiucqptVV66lwO9qvxKReFfe1a+9Y/oJ9HdzgsnBNL4JBzgsnBNL4JCvBagUHOCycE0vgkHOCycE0vgkK8CoFBzgsnBNL4JBzgsnBNL4JCvAqBQc4LJwTS+CQc4LJwTS+CQrwKgUHOCycE0vgkHOCycE0vgkK8CoETXWKytoalzbVSoqQvVFSNM0XVUqrOqutNE5yqqrTRqqr1/Yodlw9wVXcJPFU67N1Hoe9ovFQn0VhD4f8AdF5/OUniMJgh8P8Aui8/nKTxGATAAKAAAAAAAAAAAAAAQtk6tYh78h+zxk0Qtk6tYh78h+zxkn4Jojqvq3be51P0MJEjqvq3be51P0MEiRABQAAAAAAAAAAAAAAAAAAAAAUFv93XTvln1EZXlBb/AHddO+WfURleAAAAzW9TE6u6U+8sPfWXMwpM1vUxOrulPvLD31lzOfl/ErjyzyAB43QAAAAAAABqh5NL8aTH/d7b+6qM8VPauTS/Gkx/3e2/uqjPFT3YfmHKeQAGgIXDX8be/wA7z+KwmiFw1/G3v87z+KwgmgAUAAAAAAAAAAAAAAAAAAAIe4++Wy9yrPojJgh7j75bL3Ks+iMk8CYIzEXUv/M0v2iMkyMxF1L/AMzS/aIyyQk13QF3QAAAAAAAAAAAAAACFr/fbZu9K7/sk0Qtf77bN3pXf9kkiaIzEUk0dtakM8kLpKqmiV8btVyNdMxrkRetmiqhJkViTqfF39R/aGCeB2LZIc+qVz424c5IuErnxtxIrugtCO5yRcJXPjbhzki4SufG3EiAI7nJFwlc+NuHOSLhK58bcSIAjuckXCVz424c5IuErnxtxIgCO5yRcJXPjbhzki4SufG3EiAI7nJFwlc+NuOukgdR3p1K2sqpYn0aSas0qvydyxUzTPc2EqR/9Iv8gn1qkEgACgZtepjdVNKHe1h8e4mEpm16mN1U0od7WHx7ic/L+JXHlncADxugAAAAAAAAAALU0sfyWYy/w/c
  fs0hpcovcVP3Fniobo9LP8leMv8P3H7NIaXKL3FT9xZ4qHo8H1jN3AA9DLh3tV+JSLwr72rX3rH9BKO9qvxKReFfe1a+9Y/oJ9EqACgAAAAAAAAAAKe4e4KruEniqddm6j0Pe0Xiodlw9wVXcJPFU67N1Hoe9ovFQn0VhD4f90Xn85SeIwmCHw/7ovP5yk8RgEwACgAAAAAAAAAAAAAELZOrWIe/Ifs8ZNELZOrWIe/Ifs8ZJ+CaI6r6t23udT9DCRI6r6t23udT9DBIkQAUAAAAAAAAAAAAAAAAAAAAAFBb/AHddO+WfURleUFv93XTvln1EZXgAAAM1vUxOrulPvLD31lzMKTNb1MTq7pT7yw99Zczn5fxK48s8gAeN0AAAAAAAAaoeTS/Gkx/3e2/uqjPFT2rk0vxpMf8Ad7b+6qM8VPdh+Ycp5AAaAhcNfxt7/O8/isJohcNfxt7/ADvP4rCCaABQAAAAAAAAAAAAAAAAAAAh7j75bL3Ks+iMmCHuPvlsvcqz6IyTwJgjMRdS/wDM0v2iMkyMxF1L/wAzS/aIyyQk13QF3QAAAAAAAAAAAAAACFr/AH22bvSu/wCyTRC1/vts3eld/wBkkiaIrEnU+Lv6j+0MJUisSdT4u/qP7QwTwQlV3QF3QUAAAAAAAAAAAI/+kX+QT61SQI/+kX+QT61QJAAADNr1MbqppQ72sPj3EwlM2vUxuqmlDvaw+PcTn5fxK48s7gAeN0AAAAAAAAAABaelr+SrGf8Ah+4/ZpDS7Re4qfuLPFQ3RaW/5KcZ/wCHrj9mkNLtF7ip+4s8VD0eD6xm7gAehlw72q/EpF4V97Vr71j+glHe1X4lIvCvvatfesf0E+iVABQAAAAAAAAAAFPcPcFV3CTxVOuzdR6HvaLxUOy4e4KruEniqddm6j0Pe0XioT6Kwh8P+6Lz+cpPEYTBBusd2hq6ue2YgSmiq5lndE6kbJquVqIuSqqbPYoJE4CF52Yn7K2fq5nnDnZifsrZ+rmecL/gmgQvOzE/ZWz9XM84icRXC94ap4aisxFPOk8nKmMp7VG9yu+LWTfQXXIvAFm2W53y8wVNSt9qqCOlyV7q20MiTLJVzT2W4mW0+7Dc6/EjJn2rGjJOZ36j2utrGuTedlrbi9ZSail3gsuku16r7FLf6K/1U8UT3M5THaGOmcqORNjUdt3c/iKaxYkvWIK1KKjudzj2ua+WayMbHG5qbWudrrkuzLIaoKX6Cz6W7VdbeZrBTY5hfWQJmred7MnL12tXW2qnXTyLlG3LGFZbbtPZuiCuq5qXJahaWytkSLPfydn8iKNUFPQgQUNDiSeGOePFbdSRqPbrW1iLkqZpmirmh987MT9lbP1czzi3/BNELZOrWIe/Ifs8Y52Yn7K2fq5nnFRZrTPbXVk9XcFrKitmbLI/lSRomTGsREanwNQciSI6r6t23udT9DCRKC526prJqepo7gtJNT66I7lTZEcjkRFTJfiQSK8ERzuxD2TJxFnlHO7EPZMnEWeUWJcERzuxD2TJxFnlHO7EPZMnEWeUWJcERzuxD2TJxFnlHO7EPZMnEWeUWJcERzuxD2TJxFnlHO7EPZMnEWeUWJcERzuxD2TJxFnlHO7EPZMnEWeUWJcERzuxD2TJxFnlHO7EPZMnEWeUWJcERzuxD2TJxFnlHO7EPZMnEWeUWJcERzuxD2TJxFnlHO7EPZMnEWeUWJcERzuxD2TJxFnlHO7EPZMnEWeUWKi3+7rp3yz6iMryitlBPRJO6qrVqpqiVJHv5WjE2Na1ERE+BqFaUAAAM1vUxOrulPvLD31lzMKTNb1MTq7pT7yw99Zczn5fxK48s8gAeN0AAAAAAAAaoeTS/Gkx/wB3tv7qozxU9q5NL8aTH/d7b+6qM8VPdh+Ycp5AAaAhcNfxt7/O8/isJohYrLdqSprZbfeo4oqypdUqx9Mj1a5yIipnvexJImgRXMWJOH6fiaDmLEnD9PxNBYlQRXMWJOH6fiaDmLEnD9PxNBYlQRXMWJOH6fiaDmLEnD9PxNBYlQRXMWJOH6fiaDmLEnD9PxNBYlQRXMWJOH6fiaDmLEnD9PxNBYlQRXMWJOH6fiaDmLEnD9PxNBYlQRXMWJOH6fiaDmLEnD9PxNBYlQRXMWJOH6fiaDmLEnD9PxNBYlSHuPvlsvcqz6Iz75ixJw/T8TQ4gtFxdc6a43K7MqOZWSsjjZAjNr9XNVX/ANo5EsRmIupf+ZpftEZJlJdaF9xoX0kc/KHq+N7JNXW1XMe16bOvtaWRVrugiuYsScP0/E0HMWJOH6fiaEsSoIrmLEnD9PxNDprEvVvppK2txNSQwRJm+R1GmTUzyFibBaVsxEy81baG1Y6t9VUOarkjZRLmqJurtQr4pLrPWzW6HFdC+qp2o6WFKVusxF3FVBqsTwICOe5zTVdPFiujdJQ5c0tSjTOLNM9v6EUiqfGNBVzw01NpDtkktQ9I4mJRrm96qiIibN3anyjVAvQEC+S6x18drkxXQtrJWLIyBaVuu5qbqohR3W+rY52013xzbqWZzOWJG+kzdq/1lRM8k+FRYuoELTR3utp46ujxPRzwSt1o5I6Rqtcm+inbzFiTh+n4mgsSpC1/vts3eld/2Tt5ixJw/T8TQ+YLPcFu1PdbjdWVC0sMsUbGQJGn8IrM1Vf/AGJ8on2JcisSdT4u/qP7QwlSKxJ1Pi7+o/tDBPBCVXdAXdBQAAAAAAAAAAAj/wCkX+QT61SQI/8ApF/kE+tUCQAAAza9TG6qaUO9rD49xMJTNr1MbqppQ72sPj3E5+X8SuPLO4AHjdAAAAAAAAAAAWnpb/kpxp/h64/ZpDS7Re4qfuTPFQ3Q6XP5KMaf4euP2aQ0vUXuKn7kzxUPR4PrGTuAB6GXDvar8SkXhX3tWvvWP6CUd7VfiUi8K+9q196x/QT6JUAFAAAAAAAAAAAU9w9wVXcJPFU67N1Hoe9ovFQ7Lh7gqu4SeKp12bqPQ97ReKhPorAAUAAAITFGG48TR0VNUOjWngqElnjkaqpKxMlVuzfyJsZKm6gmLFoVujq3SubQWxYrZaZfZ1lPStVslQ9M9XN+exqZ7mX/AMZfEGjmGy1cNzwxdqqmq4lax61UizxyQomWoqLtyy3NpeWSp1gZ0wWtCwYaxfh5rKOkvlrdQpPy1zH0j1kVFVNZEdrbF2bNh3RYVvFHbLlQW69R00lxrn1CzpEqujidutbt9v8ACXTkqbqDJd3IumBY66JrFDGkluuFygqoldJBKtSrkjlXL2WrubVRNzIpbno/xRd3JJcbxZqmozRW1i0LoqiDLrMdG5M0+M9CBNEFqe300tHQ09JPVyVUkMTWPmk9tIqJkrl+FSoANAAAAAAAHTzXSLMtOlVDy1Nix8sTW+TPMDuBwrmtVrXORFcuTUVd1fgOEkjV6xJI1XtRFVuaZom/kB9A+Y5I5W68UjXtXZrNVFT5UPierpKXLmmqhh1tzlkiNz+UDtB8NlicjFbKxUk9oqOT2Xxb5yskaPSJZGo9yKrWqqZqibqogH0AAAB0PrqKKXlEtbTsk3NR0rUd8irmB3gp5Lhb4XrHLX0zHt3Wumaip+hVOY6+hmfyqKup3v8A6rZWqvyIoHeDpfV0kcSTyVcLYnbj1kRGr+nPIJV0iw80pVwLCmxZEkbq/LnkB3A6oaqlqc+ZqmGbLd5XIjsvkPmWuooJOUzVtPHIv8x8rWu+RVA7wAAAAAzW9TE6u6U+88PfWXMwpM1vUxOrulPvLD31lzOfl/ErjyzyAB43QAAAAAAABqh5NL8aTH/d7b+6qM8VPauTS/Gkx/3e2/uqjPFT3YfmHKeQAGgAKK5Xm02Zkcl1uEVK2VytjWTP2SpuomSAVoIZcZYTSGOo6IaNY5XOaxyOVc1bupkiZ5pmh8Oxzg5ntsSUTckzXNXJkm+uzYTVHYnARi4nw2lPNVrfqFIafU5bJy5NVmsmbdvwptTI+KHFmGLlPzNQX6jmm1VfytH5OVqbqoiomf6BcCWBCQ42wfUTMp4sS0CySLk1qyaua/AqoiHfcMUYbtNRzJcr5SU8+Wtypz83Im+qJmqC4EoCmt9zt12pkrLXXQVcCrkkkL0cme8u8vxlSUAAABHXjEFmw/HFLea9lKyZytjVyKusqbu4nwoUD8f4MjpW1jsQ03K356qJrK92W7k3LPr7xLgXACOtOIbHfketnukFUseSvYx2TmZ77V2oUlxxxhK01D6SuvtO2eN2q+NmtI5i7y6qLkLgTgIlcW4YS3Nuy36jSjdIsTZuWbFkTdaibufwZHxacZYXvs6UtrvUE07kVWxLmx7kTdVEciZ/oFwJkAFAAAAAAInFNBV3OwVdFQxtkqH6jmMc7VRyte12WfW3CWAn2LEiwLcMOUkNXhWoqZbq6NtO7muqzhgRzcnyauXslblsQj4dFV8s9Vz9s+Lny3OFXysSaFEbM9y5q17t1UXc27mZ6NVVVLQ08lZW1EcEESa0kki5Nam+qnRbrxaLwx0lpudNWNblrcpkR2XxpuoY0YlrPpIMfWy83G6wYVoajnmyJXsdXo3Uc1HKqJs2pm5U/QSDbReKS63a9UlkonTS0kK0cLntRvL9VqOTPLYiKm71y5EuFAsNRUJWwLFSq5s70eipErUzcjt7ILcKFraZ7qyJG1io2nXW/jVVM0Ru/s2l0jzx+ii+VtWl9rcZyMur3tqHOZCipHIiLk1rt1GpnufAdF5wvjm9T887hhqgS6RQ8ohrqO4cqkXJMv4RqorXNVdur1j0+aaGnidPUTRxRMTNz5HI1rU+FV2IRtFizC9xqeYqDENvnnz1UjZOmarvJv8A6CThiW+sN0tzobHR0l4dTrVxR6snKGo1ibdiIibM8ss8uvmSZ0QVtFUwPqaarhlijVyPex6KjVTdzXrZZH1TVNPW08dXSTsmgmaj45GLm1zV3FRTUDtABQIrEnU+Lv6j+0MJUisSdT4u/qP7Qwk8EJVd0Bd0FAAAAAAAAAAACP8A6Rf5BPrVJAj/AOkX+QT61QJAAADNr1MbqppQ72sPj3EwlM2vUxuqmlDvaw+PcTn5fxK48s7gAeN0AAAAAAAAAABaWlz+SjGn+Hrj9mkNL1F7ip+5M8VDdFpc/kpxp/h64/ZpDS7Re4qfuLPFQ9Hg+sZu4AHoZcO9qvxKReFfe1a+9Y/oJR3tV+JSLwr72rX3rH9BPolQAUAAAAAAAAAABT3D3BVdwk8VTrs3Ueh72i8VDsuHuCq7hJ4qnXZuo9D3tF4qE+isABQGS7xC3K20N0vkEFwp0mjZRyPa1zlREdrtTPYu8fXQhhrgiL5zvKT2JKso46+llopnysZM1WOdE9WPRF3nJtRfhPNpMN4noKKSqtkt+ciV8kNVGysctQ+kaqaqw8sXLNcl2ptVNwvfoQw1wRF853lHQhhrgiL5zvKSYstZMlDc2SwdBVHi6nr3StdJJcpXcyozP2SSJIq57P6u0msaQ4ifdqN3K7tPYuVKk8dokRk/Ls9121HKzL+qpOdCGGuCIvnO8o6EMNcERfOd5SaZLefUdNjunvs8WEbXdIaDlT0ZJdKqXVzVuxVZLnm9FTZls3M9h3MoZEokmuFsx++9MZqufHUqqLJvtcjuV6ufwbhffQhhrgiL5zvKOhDDXBEXzneUmiVt9YTjv8eHqNmJ3NdcmsVJlaqL11yzVNirllnl1yWyXeIfoQw1wRF853lIvFGHLJb8P1tdQ0DYKiBjXxyMe5HNdrJtTab9xCLsBy72y/GcFAAAACIu9JT190t1LVxrJCrZ3KzWVEVURuS7F+FRPoS+S7x47ijRli66YouF1tlJAzl9W2op6l1QxqNRP6yaqv8A0IqHpvQvYODm+Ef5R0L2Dg5vhH+Uxljq5ImlnV+BccYoq4L5eMRw2qrpV/4ampo1kZCqZey1tZNrstuxdi5HfQ0mkKgv1TfZ8NUVXNV0kdLLqVyRpmxV9kmbdxd3LrZl1dC9g4Ob4R/lHQvYODm+Ef5RpLQGAqLF1gpIbHc8O07KVsssjqpla1yprKrkTUy27dm6UM+D7tS3avq6vCNrxK2smdLFUVNVqSxMXcjVr0VERP8AlLt6F7Bwc3wj/KOhewcHN8I/yjT6oWPTaNrxJOx1TFFQUU9a2ZaGhqnI2iYjFRXMeuXslXLY1EQuG24bxJR4kpKy43SO50VJBLFDPIxGVDEcntX5bH9bamW5tJfoXsHBzfCP8o6F7Bwc3wj/ACiMaErku8C3b5h2zU1lr6iCiSOWKmlex7ZH5tcjVVFTaTlGqupIHOVVVYmKqr1/YoaHcef3vRhDinEdxuV2nfT00vK2xcpbG58iI3JyqrmqrFRUyTI9AAmIy5Hkd00ZXfnvUOo7IlVS5sbBK+shR7mNTLN3LI3Ln+lCkotDV9gbSVNVyiT+Ges9PFI2KSNFX2L2zI3NyZbVbs+A9Gislqut2u01xo2zvjqGMarnO9i3lTFyTJd9VKnoQw1wRF853lMbcStvP7Lo6xHZoqaa52O24hayFI20dTU6iUao5yryvNFY5FzRVzTPMXnRziK609XUW+x22zMlYxi22nqVcyoVHoqukXJGJkm5kh6B0IYa4Ii+c7yjoQw1wRF853lGj4WstcC3uvqKZ1uwxa8JSQSI91dR1SyTK3JUVqNaiNXP/mFJg252+ndb6zR5YrvKqrr18lbks2aqus7Xar0Xb1l+Iuu6YUw7Fa6yWK1xteynlc1yOdmioxVRd0lLI98llt8kjlc51LErnKuaqqsTapYxiy0bgmw3DDlibbbjWtnk5a+RrWOc5kDXLmkbFdtVqb6k+AaiK9IAAoGa3qYnV3Sn3nh76y5mFJmt6mJ1d0p95Ye+suZz8v4lceWeQAPG6AAAAAAAANUPJpfjSY/7vbf3VRnip7VyaX40mP8Au9t/dVGeKnuw/MOU8gANAW/irCrcTz2tJp+V09HM+SdGuVsj2q1MkY5Nxc0T9GZcAJMX6HnF+0TUKR0ceGZaShZHJLLPzXK9XTPeiZLrIqLmmSkU3QzJVNrXV+J6eCSenbFFzLIqtzRVzR+submqmWzrbS+rzb6K54ptdNcKZlRClDVvRj89XWR8KIuW/tX5Sr6EcL8BUnzV8pjREzwtrHpdFb6Sfm+lu9np6iB0UlPAkSSU2s2LUejmuXbmu1F3UzUk7hhG9YjlpkxDdrBBBSPSZnO+BGSueiKiJrqubW7dqIXL0I4X4CpPmr5R0I4X4CpPmr5S6EtZyYHxLUWNmGa284ZbQpGsKzMpEfOjVXPNFVdi/CVtrwJfMLvmbhi5Wmqp6hddVudNyyZF1UT+MbtcmzcUuVuEcL6yf+BUm7/VXynGFGMisFPFG3VYx8zWpvIkz0RPkEY+y1HhPCs9hqbhc66rglrLo5jpmUsKQwR6qZIjWp199euXGAaiKHy6SJmySVjM/wCs5E+k+eX0/wCUw+Eb5S35rTbLri2uS5UUdSkVBS8rSTNUbm+bPL48k+QrehHC/AVJ81fKPY+sRUFPfbJW2ltbTRvqoljbI5zXai7Nu78Bb9Rg+rorvJfsNX62w1U9NFTzRVkDJY15W1Go5vXbubSe6EcL8BUnzV8o6EcL8BUnzV8pJixF2PDEtLiB+Kr5e6Kor3U3MrWUsTIYmszRVzRFzcufXUoaLCN4w4tRDhbEdoSlqZ3T8rr6ZksjFcuaproubtu+XF0I4X4CpPmr5R0I4X4CpPmr5SaS1qJo4lSsivy4tp33iKpkqGq+GNaRqPTJWJDuJs/nbpWdCNzvFyt1wxXiC1vS11HNMEVvgbCrnp7XWfnnlvpuKT/QjhfgKk+avlHQjhfgKk+avlGktJ80U/5TD4RvlPpskT1yjljeqdZr0X6CK6EcL8BUnzV8pRraLXacTWlbZQxUyzQ1aScrzTWREjyzNexcYAKAAAHw6aFq6rp4mqm6ivRFPtN0taw4fsdxpqqrr7XBUTvuFYjpJEVXKiTvROv1kREJMitxham4lwzX2Knr6WGSsjRjXyPRWtVHIu1EX4Cx7Lo2xHYq6qq7Tii1UHN9PHSTrE5z3Ixqpm9iuXY/JMk6yZl+9COF+AqT5q+UdCOF+AqT5q+UzONzclrJi0WVFkp6uHDWMUc24wvpqyKuc1zJGOaqa3sVz10Vc8yRXD+L3U9mp3XLDeVjcx8C5yezVrUamt7LeTrFy9COF+AqT5q+UdCOF+AqT5q+URhXBaJxHh2vxZh+Ggul2t1PW09U2qbyhyuppdRfYska5c3NXroRV1wfe8Q0rbVcX4Vt9MkjHuqaCLKoTVVFzjVV9guaf6l19COF+AqT5q+UdCOF+AqT5q+UTjZaz7VoujtlqqI6bFC0lznfMjqmCVFjmifsRkrFXJ2xd3dLuwpbWYew5b7JNX00slFCkTnseiNcqKu5mp9dCOF+AqT5q+UdCOF+AqT5q+URjXAlWvY9M2Pa5N9rkVP9D6Lfw9R0lvvl9pKGBsEDX0zmxsz1UVYtqp8ZcBqPYEViTqfF39R/aGEqRWJOp8Xf1H9oYJ4ISq7oC7oKAAAAAAAAAAAEf/SL/IJ9apIEf/SL/IJ9aoEgAABm16mN1V0od7WDx7iYSmbXqY3VXSh3tYPHuJz8v4lceWdwAPG6AAAAAAAAAAAsvTZXQWzQ1j25VSu5TSYYuk8mqma6raSRVyT4kNMtIitpIGr1omJ/+qG4TkmWo/kb9K7XbjsEX1F2/wD8CY0+0/ueLubfoQ9Hg+sZOwAHoZcO9qvxKReFfe1a+9Y/oJR3tV+JSLwr72rX3rH9BPolQAUAAAAAAAAAABT3D3BVdwk8VTrs3Ueh72i8VDsuHuCq7hJ4qnXZuo9D3tF4qE+isABRHP8AfFF3i/6xpIkc/wB8UXeL/rGkiSAABQAAAAACExp71bl3JPGQmyExp71bl3JPGQk8EJx3tl+M4KC+3mnsVItdU01XOxZEj1aaFZH5rntyTrbN0gfwlWfga/fq93lE5RHIu0Hn1VcaVud3ptJdRbkmV0q0dYxr3RK/cY6PdblvZEZJj/ElEqxW+6Ud+cz+C1WUErHOkVd1ckRMjM5xBT1Qjqvq3be51P0MIax4nxJcHUiVmF5Y2zuRkzkR8fKN9Xa6ZKm9kqkzV9W7b3Op+hhbuBIgA0AAAAAAAAI7Efveufec3iKVdF7ip+4s8VCkxH73rn3nN4ilXRe4qfuLPFQn0dwAKIy1dUbx32z6mMkyMtXVG8d9s+pjJMkAACijvHUiv71m8RT4sPUK3d6Q+Ih93jqRX96zeIp8WHqFbu9IfEQn0V4AKAAAGa/qYqN59aUna21aTD6K3LcTXue36fkMKDNb1MTq7pT7zw99Zczn5fxK48s8gAeN0AAAAAAAAaoeTSTLko8fLnuzW3910Z4qe1cml+NHj7u1t/ddGeKnuw/MOU8gANAAAIWr9+Fs/N9Z48BNELV+/C2fm+s8eAmiR9AAFHLfbJ8ZE4X6iQ91n+ueSzfbJ8ZE4X6iQ91n+ueT6JUAFENS++65fm+k8eYmSGpffdcvzfSePMTJIAAFAAAAAAIe4++Wy9yrPojJgh7j75bL3Ks+iMk8CYBBYhxDc7LPDDQYVrrq2RiudJTuajWLnlqrn1+uQlZjO51NJNTXXAd4pKKZix1FRy5reUxqmTn5ptTJFVdm8JyiCl8q1ybrVT9BweTSVmGoVXoaxpidXTPRjEp4nTsRW/CvWPukv2lSSeNbVTVlXTSyZ61dRta5jE3ev1zOsp6sm6Q2FOptR+ca77RIc4fqcT1Ek3P6gp6eLJqwOY7+EVc1zRzdxNmXynGFOptR+ca77RIa5kTIAKAAAAAAAAIW1e+S/wD/AFUn1JNELavfJf8A/qpPqSaJAEViTqfF39R/aGEqRWJOp8Xf1H9oYJ4ISq7oC7oKAAAAAAAAAAAEf/SL/IJ9apIEf/SL/IJ9aoEgAABm56mM1EuOk5+suawWJMsusjrht/1X5DCMza9TGz56
  aT9uzmaw7P8A33E5+X8SuPLO4AHjdAAAAAAAAAAAebckv+LjpV/wRffsExp8p/c8Xc2/QhuD5Jf8XHSr/gi+/YJjT5T+54u5t+hD0eD6xm7AAehlw72q/EpGYVRehq17P/Sx/QShFR4ZtUMbYoUq442Jk1jK2ZGtTeREfsQn0SuS7wyXeIzoet39pXcfn88dD1u/tK7j8/nl9iTyXeGS7xGdD1u/tK7j8/njoet39pXcfn88exJ5LvDJd4jOh63f2ldx+fzx0PW7+0ruPz+ePYk8l3hku8RnQ9bv7Su4/P546Hrd/aV3H5/PHsSeS7wyXeIzoet39pXcfn88dD1u/tK7j8/nj2Ky4IvMFVs/8iTxVOqzdR6HvaLxUKd2HLY9qse6tVrkVFRa+fanzyRiijgiZBE1GsjajGonWREyRCD7ABRHP98UXeL/AKxpIkc/3xRd4v8ArGkiSAABQAAAAACExp71bl3JPGQmyExp71bl3JPGQk8EJx3tl+M4zXfKW7V/OyjmruZKip5VkvKoGaz1zVE2J8Gea/AiljXbSvNb6hKZuH1jXlXLHSTzORjM/aovsUE5RjyLybh2wMnlqkstDy6dyvkesDVc92eeaqqbuZXsYyNMo2Nam81Mjz+mxXia8NckGJMK29VY1MuWK97Hr1snbF2ExDfYcMK5uKsWMrZKvJ8HK6XJkaNTJyIrEXdVc9pImCl1EdV9W7b3Op+hhGN0iYQc5rUuy5uVGp/ASbq/+0k6zq5be51P0MEzE8CRABoAAAAAAAAR2I/e9c+85vEUq6L3FT9xZ4qFJiP3vXPvObxFKui9xU/cWeKhPo7gAURlq6o3jvtn1MZJkZauqN477Z9TGSZIAAFFHeOpFf3rN4inxYeoVu70h8RD7vHUiv71m8RT4sPUK3d6Q+IhPorwAUAAAM1vUxOrulPvLD31lzMKTNb1MTq7pT7yw99Zczn5fxK48s8gAeN0AAAAAAAAaoeTS/Gjx93e2/uujPFT2rk0vxo8fd3tv7rozxU92H5hynkABoAABC1fvwtn5vrPHgJohav34Wz831njwE0SPoAAo5b7ZPjInC/USHus/wBc8lm+2T4yJwv1Eh7rP9c8n0SoAKIal991y/N9J48xMkNS++65fm+k8eYmSQAAKAAAAAAQ9x98tl7lWfRGTBD3H3y2XuVZ9EZJ4ExmqbinDkR7VY9Ec1yZKi7UVCKv9bfqKKJ1jtTKxz1VJFcq5x7mSo1FTW6/X6xYNxxhpLZUTw1VsktkCSNjjlioFmX4XbFzyJOVFPUooYoURtPAyPeRjET6D7VXZ5OVf0nlLLvbbk58V60n3en5ZKjEiWmWnRFTdTc65c9Fi+noqWKjt9ivdypoG6kVY1qPSoam49HddF3xGUFLuTdIbCnU2o/ONd9okFmxI+71a0rrBcqJGsV/LKhiIxdqJlnv7f8ARRhTqbUfnGu+0SFu5EyACgAAAAAAACFtXvkv/wD1Un1JNELavfJf/wDqpPqSaJAEViVzW22Jz3I1EraPNVXJE/4hhKnVVUtNWwOpaynZNC/LWY9M0XJc0/1QsgtXR5+7afwzfKOa6P8ALKfwzfKUHQthvgOj+YOhfDfAdH8wnsV/NdH+WU/hm+Uc10f5ZT+Gb5Sg6FsN8B0fzB0L4b4Do/mD2K/muj/LKfwzfKOa6P8ALKfwzfKUHQvhvgOj+YOhfDfAdH8wexX810f5ZT+Gb5RzXR/llP4ZvlKDoXw3wHR/MHQvhvgOj+YPYr+a6P8ALKfwzfKOa6P8sp/DN8pQdC+G+A6P5g6FsN8B0fzB7FfzXR/llP4ZvlKFksMuIl5VNHJlQJnqPR2X8Ku8cdC+G+A6P5hU0Vptdtc99vt8FO6RER6xtyVyJuIo9irABQM2/Uxuqek/vaw+PcTCQzb9TG6p6T+9rD49xOfl/ErjyztAB43QAAAAAAAAAAHmvJMuRvI36VnOXJEwRfVXiExp9p/c8Xc2/QhuZ002+mu2hzHdqrWudT1mGbpTyo12Sqx9LI12S9bYqmmSkcrqSBy7qxMX/RD0eD6xk7gAehkAAAAAAAAAAAAAAAAAAAAARz/fFF3i/wCsaSJHP98UXeL/AKxpIkgAAUAAAAAAhMae9W5dyTxkJshMae9W5dyTxkJPBCcd7ZfjPh7GStVkrGvau6jkzRT7d7ZfjOCiLq8LYbrs1q7FQyKrkcq8oaiqu/mm05s+HLLYOaEtNC2nSqekkqI5zkVydf2Srl+gkwSoHGqxNqMb8hH1fVu29zqfoYSJHVfVu29zqfoYJEiACgAAAAAAACOxH73rn3nN4ilXRe4qfuLPFQpMR+96595zeIpV0XuKn7izxUJ9HcACiMtXVG8d9s+pjJMjLV1RvHfbPqYyTJAAAoo7x1Ir+9ZvEU+LD1Ct3ekPiIfd46kV/es3iKfFh6hW7vSHxEJ9FeACgAABmt6mJ1d0p954e+suZhSZr+pir/43pSbqpso8PLn11/hLn/8A79Jz8v4lceWeIAPG6AAAAAAAANUXJp/jR497tbf3XRnih7VyaSqvJSY+RV3JraifqujPFT3YfmHKeQAGgAAELV+/C2fm+s8eAmiErpI48X2tZJGMRbfWe2cifz4N8l+aab8qg8K3ykj6OwHXzTTflUHhW+Uc0035VB4VvlKO1vtk+MicL9RIe6z/AFzySbU02sn/ABUG7/at8pGYWVHWOFWqioss+SouafxzyfRLAAohqX33XL830njzEyQkEsUeL7ikk0bM7fSZazkT/wAybfJfmmm/KoPCt8pIHYDr5ppvyqDwrfKOaab8qg8K3ylHYDr5ppvyqDwrfKOaab8qg8K3ygdgOvmmm/KoPCt8o5ppvyqDwrfKB2EPcffLZe5Vn0RkpzTTflUHhW+Uia+WGTEtlSOaN68qrNjXovWj3iTwJoaztzNQCjpmpKSoTKopIJdufs40XadkUbKeJsEDGxxsTVaxiZNam8iH0AOc1VUzVVIXCnU2o/ONd9okJlN0g8LT07bdUNdURNVLjXbFeiKn/ESE+icB180035VB4VvlHNNN+VQeFb5SjsB180035VB4VvlHNNN+VQeFb5QOwHXzTTflUHhW+Uc0035VB4VvlA7AdfNNN+VQeFb5RzTTflUHhW+UCJtXvkv/AP1Un1JNEJaHskxHf1jka9Nak2tcip/E/ATZIAAFAAAAAAAAAAAAAAAAAAADNv1MZF556T1zTLmew7Ov7e4mEhm16mM5eeek9mexKewqnxq+4+Q5+X8SuPLO4AHjdAAAAAAAAAAAW3pLpKqv0cYqoaGmlqKmpsldFDDExXvke6B6Na1qbVVVVERE2qqmo6j0D6cW0cDXaGcdIqRMRUXDtZmi6qf/AIzcqDph5JwSYtpw/ARpw7TWOf2drPRj8BGnDtNY5/Z2s9Gbjwb356TS04fgI04dprHP7O1nox+AjTh2msc/s7WejNx4G/PRpacPwEacO01jn9naz0Y/ARpw7TWOf2drPRm48Dfno0tOH4CNOHaaxz+ztZ6MfgI04dprHP7O1nozceBvz0aWnD8BGnDtNY5/Z2s9GPwEacO01jn9naz0ZuPA356NLTh+AjTh2msc/s7WejH4CNOHaaxz+ztZ6M3Hgb89Glpw/ARpw7TWOf2drPRj8BGnDtNY5/Z2s9GbjwN+ejS04fgI04dprHP7O1nox+AjTh2msc/s7WejNx4G/PRpacPwEacO01jn9naz0Y/ARpw7TWOf2drPRm48Dfno0tMlXyOumisnZUu0QaQopY2LGjobJWxqrVVFVFyj27UQ6+lw02dqzSZ+qa70ZufA356NLTB0uGmztWaTP1TXejHS4abO1ZpM/VNd6M3Pgb89Glpg6XDTZ2rNJn6prvRjpcNNnas0mfqmu9GbnwN+ejS0wdLhps7Vmkz9U13ox0uGmztWaTP1TXejNz4G/PRpaYOlw02dqzSZ+qa70Z11PIz6ZKyB9NV6JdJM0MmSPjfaa9WuTPPJfYfAbowN6ejS04LoJ04Kuf4G8c/s7WejH4CNOHaaxz+ztZ6M3Hgb89Glpw/ARpw7TWOf2drPRj8BGnDtNY5/Z2s9GbjwN+ejS04fgI04dprHP7O1noylrOR3001z4pZND2kCOSDW1Hw2OtYqI7LNNke3cQ3Mgb89Glpg6XDTZ2rNJn6prvRjpcNNnas0mfqmu9GbnwN+ejS0wdLhps7Vmkz9U13ox0uGmztWaTP1TXejNz4G/PRpaYOlw02dqzSZ+qa70Y6XDTZ2rNJn6prvRm58Dfno0tMHS4abO1ZpM/VNd6MdLhps7Vmkz9U13ozc+Bvz0aWl2bkatM9TDJTz6KNJT4pWqx7VtNfk5q7FT2hIs0C6bo2NjZoaxyjWIjUToerNxP8A+s3Igb89Glpw/ARpw7TWOf2drPRj8BGnDtNY5/Z2s9GbjwN+ejS0wycjhpnfUTVTNEekWF87kdIkVmrmNcqIjc8kZluIhx0uGmztWaTP1TXejNz4G/PRpaYOlw02dqzSZ+qa70Y6XDTZ2rNJn6prvRm58Dfno0tL0vI2aaJonwy6KdJbmSNVjmraa/aipkqe0K6n0A6a6WCOmg0MY5bHCxsbE6HqxcmomSJ/F7xuTA356NLTh+AjTh2msc/s7WejH4CNOHaaxz+ztZ6M3Hgb89Glpw/ARpw7TWOf2drPRj8BGnDtNY5/Z2s9GbjwN+ejS04fgI04dprHP7O1nozLv1OzAGO8EXnSRLjPBV+sDK6ksTaV10ts1Kk6xvuKyIxZGprK3ljM8s8tdue6hmoDOXlnKKIxoAByaAAAAAAAAa1+Sy0HaaMV8kXjTEmFtFWI7vaa+WgdS1tJBG6KZGW6ljdqqr0XY9j2rs3WqeSdLdyRHaPxfxWL0huDB1jzZRFM6WnzpbuSI7R+L+KxekHS3ckR2j8X8Vi9IbgwXfyNMNPnS3ckR2j8X8Vi9IOlu5IjtH4v4rF6Q3Bgb+Rphp2qORg091atWr0CYqmVmeqr6OJVbnu5fwnwIdXSracf7vmJuJRekNxwJvZGmGnHpVtOP93zE3EovSDpVtOP93zE3EovSG44Dek0w049Ktpx/u+Ym4lF6QqYuRo5IKCNsMGgrFscbEya1tJEiJ/uG4UF3sjTDT50t3JEdo/F/FYvSDpbuSI7R+L+KxekNwYG9kaYadZ+Rd08VUnLqnQFimV+WrrPo4lXLez5Z8KnX0q2nH+75ibiUXpDccCb2Rphpx6VbTj/AHfMTcSi9IOlW04/3fMTcSi9IbjgN6TTDTj0q2nH+75ibiUXpB0q2nH+75ibiUXpDccBvSaYacelW04/3fMTcSi9IOlW04/3fMTcSi9IbjgN6TTDTj0q2nH+75ibiUXpDsg5F3TxTSctptAWKYn5Kms2jiRct7+MNxQG9kaYafOlu5IjtH4v4rF6QdLdyRHaPxfxWL0huDBd/I0w0+dLdyRHaPxfxWL0g6W7kiO0fi/isXpDcGBv5GmGnzpbuSI7R+L+KxekKV/IsadJHukfyP2J3Oequcq0UWaqu6v8YbjQN7I0w049Ktpx/u+Ym4lF6QdKtpx/u+Ym4lF6Q3HAm9Jphpx6VbTj/d8xNxKL0g6VbTj/AHfMTcSi9IbjgN6TTDTj0q2nH+75ibiUXpB0q2nH+75ibiUXpDccBvSaYacelW04/wB3zE3EovSDpVtOP93zE3EovSG44Dek0w070/IxafaRHJSaBsVQo9c3alHEmsvw/wAIdvS3ckR2j8X8Vi9IbgwXeyNMNPnS3ckR2j8X8Vi9IOlu5IjtH4v4rF6Q3Bgb+Rphp86W7kiO0fi/isXpB0t3JEdo/F/FYvSG4MDfyNMNPnS3ckR2j8X8Vi9IOlu5IjtH4v4rF6Q3Bgb+Rphp86W7kiO0fi/isXpB0t3JEdo/F/FYvSG4MDfyNMNPnS3ckR2j8X8Vi9IOlu5IjtH4v4rF6Q3Bgb+Rphp86W7kiO0fi/isXpB0t3JEdo/F/FYvSG4MDfyNMNPnS3ckR2j8X8Vi9IOlu5IjtH4v4rF6Q3Bgb+Rphp86W7kiO0fi/isXpB0t3JEdo/F/FYvSG4MDfyNMNPnS3ckR2j8X8Vi9IZc+p7aMtI+jy46Q5sfYFvGHWXKCyso1uEbWc0LE6uWRGarlz1eWx5/9aGZQM5eWcoqSMaAAc2gAAAAAAAAAAAAAAAAAAAAAAAAAAAAAAAAAAAAAAAAAAAAAAAAAAAAAAAAAAAAAAAAAAAAAAAAAAAAAAAAAAAAAAAAAAAAAAAAAAAAAAAAAAAAAAAAAAAAAAAAAAAAAAAAAAAAAAAAAAAAAAAAAAAAAAAAAAAAAAAAAAAAAAAAAAAAAAAAAAAAAAAAAAAAAAAAAAAAAAAAAAAAAAAAAAAAAAAAAAAAAAAAAAAAAAAAAAAAAAAAAAAAAAAAAAAAAAAAAAAAAAAAAAAAAAAAAAAAAAAAAAAAAAAAAAAAAAAAAAAAAAAAAAAAAAAAAAAAAAAAAAAAAAAAAAAAAAAAAAAAAAAAAAAAAAAAAAAAAAAAAAAAAAAAAAAAAAAAAAAAAAAAAAAAAAAAAAAAAAAAAAAAAAAAAAAAAAAAAAAAAAAAAAAAAAAAAAAAAAAAAAAAAAAAAAAAAAAAAAAAAAAAAAAAAAAAAAAAAAAAAAAAAAAAAAAAAAAAAAAAAAAAAAAAAAAAAAAAAAAAAAAAAAAAAAAAAAAAAAAAAAAAAAAAAAAAAAAAAAAAAAAAAAAAAAAAAAAAAAAAAAAAAAAAAAAAAAAAAAAAAAAAAAAAAAAAAAAAAAAAAAAAAAAAAAAAAAAAAAAAAAAAAAAAAAAAAAAAAAAAAAAAAAAAAAAAAAAAAAAAAAAAAAAAAAAAAAAAAAAAAAAAAAAAAAAAAAAAAAAAAAAAAAAAAAAAAAAAAAAAAAAAAAAAAAAAAAAAAAAAAAAAAAAAAAAAAAAAAAAAAAAAAAAAAAAAAAAAAAAAAAAAAAAAAAAAAAAAAAAAAAAAAAAAAAAAAAAAAAAAAAAAAAAAAAAAAAAAAAAAAAAAAAAAAAAAAAAAAAAAAAAAAAAAAAAAAAAAAAAAAAAAAAAAAAAAAAAAAAAAAAAAAAAAAAAAAAAAAAAAAAAAAAAAAAAAAAAAAAAAAAAAAAAAAAAAAAAAAAAAAAAAAAAAAAAAAAAAAAAAAAAAAAAAAAAAAAAAAAAAAAAAAAAAAAAAAAAAAAAAAAAAAAAAAAAAAAAAAAAAAAAAAAAAAAAAAAAAAAAAAAAAAAAAAAAAAAAAAAAAAAAAAAAAAAAAAAAAAAAAAAAAAAAAAAAAAAAAAAAAAAAAAAAAAAAAAAAAAAAAAAAAAAAAAAAAAAAAAAAAAAAAAAAAAAAAAAAAAAAAAAAAAAAAAAAAAAAAAAAAAAAAAAAAAAAAAAAAAAAAAAAAAAAAAAAAAAAAAAAAAAAAAAAAAAAAAAAAAAAAAAAAAAAAAAAAAAAAAAAAAAAAAAAAAAAAAAAAAAAAAAAAAAAAAAAAAAAAAAAAAAAAAAAAAAAAAAAAAAAAAAAAAAAAAAAAAAAAAAAAAAAAAAAAAAAAAAAAAAAAAAAAAAAAAAAAAAAAAAAAAAAAAAAAAAAAAAAAAAAAAAAAAAAAAAAAAAAAAAAAAAAAAAAAAAAAAAAAAAAAAAAAAAAAAAAAAAAAAAAAAAAAAAAAAAAAAAAAAAAAAAAAAAAAAAAAAAAAAAAAAAAAAAAAAAAAAAAAAAAAAAAAAAAAAAAAAAAAAAAAAAAAAAAAAAAAAAAAAAAAAAAAAAAAAAAAAAAAAAAAAAAAAAAAAAAAAAAAAAAAAAAAAAAAAAAAAAAAAAAAAAAAAAAAAAAAAAAAAAAAAAAAAAAAAAAAAAAAAAAAAAAAAAAAAAAAAAAAAAAAAAAAAAAAAAAAAAAAAAAAAAAAAAAAAAAAAAAAAAAAAAAAAAAAAAAAAAAAAAAAAAAAAAAAAAAAAAAAAAAAAAAAAAAAAAAAAAAAAAAAAAAAAAAAAAAAAAAAAAAAAAAAAAAAAAAAAAAAAAAAAAAAAAAAAAAAAAAAAAAAAAAAAAAAAAAAAAAAAAAAAAAAAAAAAAAAAAAAAAAAAAAAAAAAAAAAAAAAAAAAAAAAAAAAAAAAAAAAAAAAAAAAAAAAAAAAAAAAAAAAAAAAAAAAAAAAAAAAAAAAAAAAAAAAAAAAAAAAAAAAAAAAAAAAAAAAAAAAAAAAAAAAAAAAAAAAAAAAAAAAAAAAAAAAAAAAAAAAAAAAAAAAAAAAAAAAAAAAAAAAAAAAAAAAAAAAAAAAAAAAAAAAAAAAAAAAAAAAAAAAAAAAAAAAAAAAAAAAAAAAAAAAAAAAAAAAAAAAAAAAAAAAAAAAAAAAAAAAAAAAAAAAAAAAAAAAAAAAAAAAAAAAAAAAAAAAAAAAAAAAAAAAAAAAAAAAAAAAAAAAAAAAAAAAAAAAAAAAAAAAAAAAAAAAAAAAAAAAAAAAAAAAAAAAAAAAAAAAAAAAAAAAAAAAAAAAAAAAAAAAAAAAAAAAAAAAAAAAAAAAAAAAAAAAAAAAAAAAAAAAAAAAAAAAAAAAAAAAAAAAAAAAAAAAAAAAAAAAAAAAAAAAAAAAAAAAAAAAAAAAAAAAAAAAAAAAAAAAAAAAAAAAAAAAAAAAAAAAAAAAAAAAAAAAAAAAAAAAAAAAAAAAAAAAAAAAAAAAAAAAAAAAAAAAAAAAAAAAAAAAAAAAAAAAAAAAAAAAAAAAAAAAAAAAAAAAAAAAAAAAAAAAAAAAAAAAAAAAAAAAAAAAAAAAAAAAAAAAAAAAAAAAAAAAAAAAAAAAAAAAAAAAAAAAAAAAAAAAAAAAAAAAAAAAAAAAAAAAAAAAAAAAAAAAAAAAAAAAAAAAAAAAAAAAAAAAAAAAAAAAAAAAAAAAAAAAAAAAAAAAAAAAAAAAAAAAAAAAAAAAAAAAAAAAAAAAAAAAAAAAAAAAAAAAAAAAAAAAAAAAAAAAAAAAAAAAAAAAAAAAAAAAAAAAAAAAAAAAAAAAAAAAAAAAAAAAAAAAAAAAAAAAAAAAAAAAAAAAAAAAAAAAAAAAAAAAAAAAAAAAAAAAAAAAAAAAAAAAAAAAAAAAAAAAAAAAAAAAAAAAAAAAAAAAAAAAAAAAAAAAAAAAAAAAAAAAAAAAAAAAAAAAAAAAAAAAAAAAAAAAAAAAAAAAAAAAAAAAAAAAAAAAAAAAAAAAAAAAAAAAAAAAAAAAAAAAAAAAAAAAAAAAAAAAAAAAAAAAAAAAAAAAAAAAAAAAAAAAAAAAAAAAAAAAAAAAAAAAAAAAAAAAAAAAAAAAAAAAAAAAAAAAAAAAAAAAAAAAAAAAAAAAAAAAAAAAAAAAAAAAAAAAAAAAAAAAAAAAAAAAAAAAAAAAAAAAAAAAAAAAAAAAAAAAAAAAAAAAAAAAAAAAAAAAAAAAAAAAAAAAAAAAAAAAB/9k=" alt="Fondo">
  
  <input type="number" name="minutes" id="minutes" placeholder="Minutos" value="00" min="0" class="input-personalizado" style="position:absolute; top: 20.5%%; left: 29.3%%; width: 5.8%%; height: 8.5%%;">
  <input type="number" name="seconds" id="seconds" placeholder="Segundos" value="00" min="0" max="60" class="input-personalizado" style="position:absolute; top: 20.5%%; left: 36.8%%; width: 5.8%%; height: 8.5%%;">

  <form action="/inicio" method="POST" style="position:absolute; top:20.5%%; left:57.5%%; width:6.2%%; height: 5%%;">
    <input type="hidden" name="minutes" id="post-minutes">
    <input type="hidden" name="seconds" id="post-seconds">
    <button type="submit" style="height:100%%; width: 100%%;">Iniciar</button>  
  </form>

  <form action="/pausa" method="POST" style="position:absolute; top:20.5%%; left:64.5%%; width:6.2%%; height: 5%%;">
    <input type="hidden" name="minutes" id="post-minutes-pausa">
    <input type="hidden" name="seconds" id="post-seconds-pausa">
    <button type="submit" style="height:100%%; width: 100%%;">Pausar</button>  
  </form>

  <form action="/reset" method="POST" style="position:absolute; top:26%%; left:57.5%%; width:6.2%%; height: 5%%;">
    <input type="hidden" name="minutes" id="post-minutes-reset">
    <input type="hidden" name="seconds" id="post-seconds-reset">
    <button type="submit" style="height:100%%; width: 100%%;">Reiniciar</button>  
  </form>

  <form action="/servo" method="POST" style "position:absolute; top:26%%; left:57.5%%; width:6.2%%; height: 5%%;">
    <input type="hidden" name="placeholder">
    <button type="submit" name="servo" value="1">Desplegar</button>
    <button type="submit" name="servo" value="0">Guardar</button>
  </form>

  <form id="miFormulario" method="POST" action="/actualizar"></form>

  <script>

    let running = %s;

    let totalSeconds = %d;
    let change = %d;

    let interval;

    updateDisplay();

    if (running){
      interval = setInterval(() => {
        if (totalSeconds += change >= 0){
        totalSeconds += change;
        updateDisplay();
        }
      }, 1000)
    }
    else{
      clearInterval(interval);
    }


    function updateDisplay(){
      let mins = Math.floor(totalSeconds / 60);
      let secs = totalSeconds %% 60;

      document.getElementById("minutes").value = 
      `${mins.toString().padStart(2,'0')}`
      document.getElementById("seconds").value = 
      `${secs.toString().padStart(2,'0')}`
    }

     // Actualizar los valores ocultos cuando cambian los inputs visibles
  document.getElementById('minutes').addEventListener('input', function() {
    document.getElementById('post-minutes').value = this.value;
    document.getElementById('post-minutes-pausa').value = this.value;
    document.getElementById('post-minutes-reset').value = this.value;
  });
  
  document.getElementById('seconds').addEventListener('input', function() {
    document.getElementById('post-seconds').value = this.value;
    document.getElementById('post-seconds-pausa').value = this.value;
    document.getElementById('post-seconds-reset').value = this.value;
  });
  
  // Inicializar los valores
  document.addEventListener('DOMContentLoaded', function() {
    document.getElementById('post-minutes').value = document.getElementById('minutes').value;
    document.getElementById('post-minutes-pausa').value = document.getElementById('minutes').value;
    document.getElementById('post-minutes-reset').value = document.getElementById('minutes').value;
    
    document.getElementById('post-seconds').value = document.getElementById('seconds').value;
    document.getElementById('post-seconds-pausa').value = document.getElementById('seconds').value;
    document.getElementById('post-seconds-reset').value = document.getElementById('seconds').value;
  });

    const valores = [%d,%d,%d,%d,%d,%d,%d,%d,%d,%d]; // Si vas a reemplazar esto dinámicamente, podés poner aquí los valores reales
    
    const posiciones = [
      { top: '23%%', left: '6.5%%' },
      { top: '20.5%%', left: '17.3%%' },
      { top: '36.5%%', left: '18.3%%' },
      { top: '36.5%%', left: '29.5%%' },
      { top: '36.5%%', left: '39%%' },
      { top: '36.5%%', left: '58.5%%' },
      { top: '36.5%%', left: '64.5%%' },
      { top: '36.5%%', left: '75.5%%' },
      { top: '20.5%%', left: '73%%' },
      { top: '23%%', left: '85%%' }
    ];

    const tamanos = [
      { width: '8%%', height: '17%%' },
      { width: '9.5%%', height: '8.5%%' },
      { width: '6%%', height: '8.5%%' },
      { width: '6%%', height: '8.5%%' },
      { width: '2.5%%', height: '8.5%%' },
      { width: '2.5%%', height: '8.5%%' },
      { width: '6%%', height: '8.5%%' },
      { width: '6%%', height: '8.5%%' },
      { width: '9.5%%', height: '8.5%%' },
      { width: '8%%', height: '17%%' },
    ];

    const formulario = document.getElementById('miFormulario');
    valores.forEach((valor, i) => {
      const div = document.createElement('div');
      const input = document.createElement('input');
      input.type = 'number';
      input.id = `numero${i + 1}`;
      input.name = `numero${i + 1}`;
      input.min = 0;
      input.max = 99;
      input.step = 1;
      input.value = valor;
      input.className = 'input-personalizado';

      // Posición
      input.style.position = 'absolute'; 
      input.style.top = posiciones[i].top;
      input.style.left = posiciones[i].left;

      // Tamaño personalizado
      input.style.width = tamanos[i].width;
      input.style.height = tamanos[i].height;

      div.appendChild(input);
      formulario.appendChild(div);
    });
   
    formulario.addEventListener('keydown', function(event) {
    if (event.key === 'Enter') {
    event.preventDefault(); // Previene que el navegador haga cosas raras
    formulario.submit();    // Envía el formulario manualmente
    }
});
  </script>
</body>
</html>

)rawliteral";


void setup(){

  //Matriz led
  matriz.begin();
  matriz.control(MD_MAX72XX::INTENSITY, 3);
  matriz.clear();
  matriz.control(MD_MAX72XX::SHUTDOWN, false);

  display.begin();
  display.control(MD_MAX72XX::INTENSITY, 3);
  display.clear();
  display.control(MD_MAX72XX::SHUTDOWN, false);

  servo1.attach(servoPin1);
  servo2.attach(servoPin2);

  servo1.write(90);
  servo2.write(90);

  Serial.begin(112500);

  //Iniciar SoftAP
  WiFi.softAP(ssid, password);
  IPAddress apIP = WiFi.softAPIP();
  Serial.println("IP del AP: ");
  Serial.println(apIP);

  dnsServer.start(53, domain, apIP);

  server.on("/", handleMenu);
  server.on("/actualizar", HTTP_POST, handleForm);
  server.on("/inicio", HTTP_POST, handleInicio);
  server.on("/pausa", HTTP_POST, handlePausa);
  server.on("/reset", HTTP_POST, handleReset);
  server.on("/servo", HTTP_POST, handleServo);

  server.begin();
  Serial.println("Servidor iniciado correctamente");

  delay(1000);

}

void loop(){
  dnsServer.processNextRequest();
  server.handleClient();

  if(running){
    tiempoActual = millis();
    if (tiempoActual - tiempoAnterior >= 1000){
      tiempoAnterior = tiempoActual;
      if(cronometro){
        tiempo++;
      }
      else{
        if(tiempo>0){
        tiempo--;
        }
      }
    }
  actualizar_display(tiempo);
  }

}

void handleMenu(){
  snprintf(bufferhtml, sizeof(bufferhtml), html, running ? "true" : "false" , tiempo, cronometro ? 1 : -1,  v1, v2, v3, v4, v5, v6, v7, v8, v9, v10);
  server.send(200, "text/html", bufferhtml);
}

void handleForm(){
  v1 = server.arg("numero1").toInt();
  v2 = server.arg("numero2").toInt();
  v3 = server.arg("numero3").toInt();
  v4 = server.arg("numero4").toInt();
  v5 = server.arg("numero5").toInt();
  v6 = v5;
  v7 = v3;
  v8 = v4;
  v9 = server.arg("numero9").toInt();
  v10 = server.arg("numero10").toInt();

  matriz.clear();
  dibujarmatriz(v1);
  

  // Muestra los tres dígitos (desde el dígito 0 en adelante)
  // matriz.setChar(0, '0' + (v2 % 10));          
  // matriz.setChar(1, '0' + ((v2 / 10) % 10));   
  // matriz.setChar(2, '0' + ((v2 / 100) % 10)); 

  
  
  server.sendHeader("Location", "/");
  server.send(302);
}

void handleInicio(){

  if(running){
    server.sendHeader("Location", "/");
    server.send(302);
    return;
  }

  if(!pausa){
    minutos = server.arg("minutes").toInt();
    segundos = server.arg("seconds").toInt();
    tiempo = minutos*60 + segundos;
    if(tiempo == 0){
      cronometro = true;
    }
    else{
      cronometro = false;
    }
  }
  else{
    pausa = false;
  }
  tiempoAnterior = millis();
  running = true;
  
  server.sendHeader("Location", "/");
  server.send(302);

}

void handlePausa(){
  running = false;
  pausa = true;
  
  server.sendHeader("Location", "/");
  server.send(302);
  
}

void handleReset(){
  running = false;
  pausa = false;
  minutos = 0;
  segundos = 0;
  tiempo = 0;
  
  server.sendHeader("Location", "/");
  server.send(302);

}

void handleServo(){
  if (server.method() == HTTP_POST){
    int valor_servo = server.arg("servo").toInt();
    if (valor_servo == 0){
      servo1.write(0);
      servo2.write(0);
      delay(50);
    }
    else if (valor_servo == 1){
      //Desplegar mecanismo
      servo1.write(180);
      servo2.write(180);
      delay(50);
    } 
  }
  server.sendHeader("Location", "/");
  server.send(302);
}

// Toma un número de segundos y los escribe en forma mm:ss en un display de 7 segmentos
void actualizar_display(uint32_t tiempo){
  int minutos = tiempo / 60;
  int segundos = tiempo % 60;

  int digito1 = minutos / 10;
  int digito2 = minutos % 10;
  int digito3 = segundos / 10;
  int digito4 = segundos % 10;

  display.setColumn(7, numerosdisplay[digito1]);
  display.setColumn(6, numerosdisplay[digito2]);
  display.setColumn(5, numerosdisplay[digito3]);
  display.setColumn(4, numerosdisplay[digito4]);

}

// Dibuja la matriz led del puntaje
void dibujarmatriz(int v1){
  if (v1<10){
    matriz.setChar(5, v1+48);
  }
  else if (v1<100){
    int decenas = v1/10;
    int unidades = v1%10;

    for(uint8_t i = 0; i<3; i++){
      matriz.setColumn(i+5, numerosmatriz[decenas][i]);
    }
    for (uint8_t i = 0; i < 3; i++) {
    matriz.setColumn(i, numerosmatriz[unidades][i]);
    }
  }
  else{
    matriz.setChar(5, 48);
  }
}
